## drivers/pn7160/nxp-6.18/nfc/Kconfig
```kconfig
#
# near field communication driver configuration
#

config NXP_NFC_I2C
	tristate "NXP NCI based NFC I2C Slave Driver for PN716x"
	depends on I2C
	help
	  This enables the NFC driver for PN716x based devices.
	  This is for I2C connected version. NCI protocol logic
	  resides in the usermode and it has no other NFC dependencies.

	  If unsure, say N.

config NXP_NFC_SPI
	tristate "NFC SPI Slave driver for NXP-NFCC"
	depends on SPI
	help
	 This enables the NFC driver for PN716x based devices.
	 This is for SPI connected version. NCI protocol logic
	 resides in the usermode and it has no other NFC dependencies.

	 If unsure, say N.
```
